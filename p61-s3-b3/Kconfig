## p61-s3-b3/Kconfig
```kconfig
if BOARD_GIGABYTE_GA_P61_S3_B3

config BOARD_SPECIFIC_OPTIONS
	def_bool y
	select BOARD_ROMSIZE_KB_4096
	select HAVE_ACPI_RESUME
	select HAVE_ACPI_TABLES
	select INTEL_INT15
	select NORTHBRIDGE_INTEL_SANDYBRIDGE
	select SERIRQ_CONTINUOUS_MODE
	select SOUTHBRIDGE_INTEL_BD82X6X
	select USE_NATIVE_RAMINIT
	select SUPERIO_ITE_IT8728F

config MAINBOARD_DIR
	string
	default "gigabyte/ga-p61-s3-b3"

config MAINBOARD_PART_NUMBER
	string
	default "GA-P61-S3-B3"

config DRAM_RESET_GATE_GPIO # FIXME: check this
	int
	default 60

config USBDEBUG_HCD_INDEX # FIXME: check this
	int
	default 2
endif
```
